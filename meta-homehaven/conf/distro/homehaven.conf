## meta-homehaven/conf/distro/homehaven.conf
```bitbake
# HomeHaven Distribution Configuration
# Inherits Poky defaults and overrides what we care about.

require conf/distro/poky.conf

DISTRO = "homehaven"
DISTRO_NAME = "HomeHaven"
DISTRO_VERSION = "0.1"
DISTRO_CODENAME = "initial"

# ── Init system ────────────────────────────────────────────────────────────────
# Use the canonical Yocto include — sets systemd, usrmerge, and all required
# VIRTUAL-RUNTIME variables in one place.
require conf/distro/include/init-manager-systemd.inc
# init-manager-systemd.inc uses ??= (weak defaults) so we must force these
# explicitly to override whatever poky.conf already set.
VIRTUAL-RUNTIME_init_manager = "systemd"
VIRTUAL-RUNTIME_initscripts = ""
VIRTUAL-RUNTIME_login_manager = "shadow-base"
VIRTUAL-RUNTIME_dev_manager = "systemd"

# ── Remove features we will never need ─────────────────────────────────────────
# No display, no desktop, no graphical stack. This is a headless server.
# sysvinit is also removed — HomeHaven is pure systemd, no SysV compat.
DISTRO_FEATURES:remove = "x11 wayland vulkan sysvinit"

# ── Networking ─────────────────────────────────────────────────────────────────
# Keep ptest disabled globally — test suites have no place in a production image.
DISTRO_FEATURES_BACKFILL_CONSIDERED:append = " ptest"
```

## meta-homehaven/conf/layer.conf
```bitbake
# We have a conf and classes directory, add to BBPATH
BBPATH .= ":${LAYERDIR}"

# We have recipes-* directories, add to BBFILES
BBFILES += "${LAYERDIR}/recipes-*/*/*.bb \
            ${LAYERDIR}/recipes-*/*/*.bbappend"

BBFILE_COLLECTIONS += "meta-homehaven"
BBFILE_PATTERN_meta-homehaven = "^${LAYERDIR}/"
BBFILE_PRIORITY_meta-homehaven = "6"

LAYERDEPENDS_meta-homehaven = "core"
LAYERSERIES_COMPAT_meta-homehaven = "walnascar"
```

## meta-homehaven/wic/homehaven-rpi4.wks
```
# HomeHaven partition layout for Raspberry Pi 4
#
# Slot design:
#   boot      — FAT32, RPi firmware reads this at power-on. Never changes between updates.
#   rootfs-a  — Active system image. Mounted read-only at runtime.
#   rootfs-b  — Standby slot. Empty on first flash. OTA writes here, then swaps active.
#   data      — Persistent user data. Survives every OS update and reflash.
#               Nextcloud files, Jellyfin media, configs, databases all live here.
#               1 GB in the flashed image; a first-boot service expands it to fill the SD card.
#
# Partition labels are used for mounting (not UUIDs) so they survive across cards.

part /boot   --source bootimg-partition --ondisk mmcblk0 --fstype=vfat --label boot     --active --align 4 --size 128
part /       --source rootfs            --ondisk mmcblk0 --fstype=ext4  --label rootfs-a         --align 4 --size 2048
part         --ondisk mmcblk0 --fstype=ext4  --label rootfs-b --align 4 --size 2048
part /data   --ondisk mmcblk0 --fstype=ext4  --label data     --align 4 --size 1024
```
